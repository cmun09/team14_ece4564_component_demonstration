// These arguments were used when this file was generated. They will be automatically applied on subsequent loads 
// via the GUI or CLI invocations. Run CLI with '--help' for additional information on how to override these arguments.
// @cliArgs --board "/ti/boards/CC3220SF_LAUNCHXL" --product "SimpleLinkSDK@3.20.00.06"
// @versions {"data":"2019051709","timestamp":"2019051709","tool":"1.1.792","templates":"2019051709"}

var RTOS = scripting.addModule("/ti/drivers/RTOS");
var GPIO = scripting.addModule("/ti/drivers/GPIO");
var GPIO1 = GPIO.addInstance();
var GPIO2 = GPIO.addInstance();
var GPIO3 = GPIO.addInstance();
var GPIO4 = GPIO.addInstance();
var GPIO5 = GPIO.addInstance();
var GPIO6 = GPIO.addInstance();
var GPIO7 = GPIO.addInstance();
var GPIO8 = GPIO.addInstance();
var GPIO9 = GPIO.addInstance();
var Timer = scripting.addModule("/ti/drivers/Timer");
var Timer1 = Timer.addInstance();
var Timer2 = Timer.addInstance();
var Capture = scripting.addModule("/ti/drivers/Capture");
var Capture1 = Capture.addInstance();
var ADC = scripting.addModule("/ti/drivers/ADC");
var ADC1 = ADC.addInstance();
var Display = scripting.addModule("/ti/display/Display");
var Display1 = Display.addInstance();
var Capture2 = Capture.addInstance();
var Power = scripting.addModule("/ti/drivers/Power");
// Name
Power.parkPins.$name = "ti_drivers_power_PowerCC32XXPins0";
var Board = scripting.addModule("/ti/drivers/Board");
// Use Hardware - Select the hardware to use, or 'none' to use available header pins
GPIO1.$hardware = system.deviceData.board.components.LED_RED;
// Name - The C/C++ identifier used in applications as the index parameter passed to GPIO runtime APIs
GPIO1.$name = "Board_GPIO_LED0";
// Name - The C/C++ identifier used in applications as the index parameter passed to GPIO runtime APIs
GPIO2.$name = "Debug_GPIO0";
// Mode - Select the GPIO mode
GPIO2.mode = "Dynamic";
// Assign pin (ignoring conflicts)
GPIO2.gpioPin.$assignAllowConflicts = "boosterpack.4"; // P03
// Name - The C/C++ identifier used in applications as the index parameter passed to GPIO runtime APIs
GPIO3.$name = "Debug_GPIO1";
// Name - The C/C++ identifier used in applications as the index parameter passed to GPIO runtime APIs
GPIO4.$name = "Debug_GPIO2";
// Name - The C/C++ identifier used in applications as the index parameter passed to GPIO runtime APIs
GPIO5.$name = "Debug_GPIO3";
// Name - The C/C++ identifier used in applications as the index parameter passed to GPIO runtime APIs
GPIO6.$name = "Debug_GPIO4";
// Name - The C/C++ identifier used in applications as the index parameter passed to GPIO runtime APIs
GPIO7.$name = "Debug_GPIO5";
// Name - The C/C++ identifier used in applications as the index parameter passed to GPIO runtime APIs
GPIO8.$name = "Debug_GPIO6";
// Name - The C/C++ identifier used in applications as the index parameter passed to GPIO runtime APIs
GPIO9.$name = "Debug_GPIO7";
// Assign pin
GPIO9.gpioPin.$assign = "boosterpack.30"; // P50
// Name - The C/C++ identifier used in applications as the index parameter passed to Timer runtime APIs
Timer1.$name = "Board_TIMER0";
// Timer Type
Timer1.timerType = "32 Bits";
// Interrupt Priority - Timer Interrupt Priority
Timer1.interruptPriority = "1";
// Name
Timer1.timer.$name = "MyTimer1";
// Name - The C/C++ identifier used in applications as the index parameter passed to Timer runtime APIs
Timer2.$name = "Board_TIMER1";
// Timer Type
Timer2.timerType = "32 Bits";
// Interrupt Priority - Timer Interrupt Priority
Timer2.interruptPriority = "1";
// Name
Timer2.timer.$name = "MyTimer1";
// Name - The C/C++ identifier used in applications as the index parameter passed to Capture runtime APIs
Capture1.$name = "Board_CAPTURE0";
// Interrupt Priority
Capture1.interruptPriority = "5";
// Name
Capture1.timer.$name = "MyTimer1";
// Assign pin
Capture1.timer.capturePin.$assign = "boosterpack.7"; // P05
// Name - The C/C++ identifier used in applications as the index parameter passed to ADC runtime APIs
ADC1.$name = "Board_ADC0";
// Name
ADC1.adc.$name = "MyADC1";
// Name - The C/C++ identifier used in applications as the index parameter passed to Display runtime APIs
Display1.$name = "Board_Display0";
// Use Hardware - Select the hardware to use, or 'none' to use available header pins
Display1.$hardware = system.deviceData.board.components.xds110Uart;
// Name - The C/C++ identifier used in applications as the index parameter passed to UART runtime APIs
Display1.uart.$name = "Board_UART0";
// Name
Display1.uart.uart.$name = "MyUART1";
// Assign pin
Display1.uart.uart.txPin.$assign = "GP01"; // pin number - 55
// Assign pin
Display1.uart.uart.rxPin.$assign = "GP02"; // pin number - 57
// Name - The C/C++ identifier used in applications as the index parameter passed to Capture runtime APIs
Capture2.$name = "Board_CAPTURE1";
// Interrupt Priority
Capture2.interruptPriority = "5";
// Name
Capture2.timer.$name = "MyTimer1";
// Assign pin
Capture2.timer.capturePin.$assign = "boosterpack.14"; // P06
// Suggest solution
GPIO1.gpioPin.$suggestSolution = "64";
// Suggest solution
GPIO3.gpioPin.$suggestSolution = "7";
// Suggest solution
GPIO4.gpioPin.$suggestSolution = "8";
// Suggest solution
GPIO5.gpioPin.$suggestSolution = "18";
// Suggest solution
GPIO6.gpioPin.$suggestSolution = "21";
// Suggest solution
GPIO7.gpioPin.$suggestSolution = "45";
// Suggest solution
GPIO8.gpioPin.$suggestSolution = "53";
// Suggest solution
Timer1.timer.$suggestSolution = "Timer1";
// Suggest solution
Timer2.timer.$suggestSolution = "Timer0";
// Suggest solution
Capture1.timer.$suggestSolution = "Timer2";
// Suggest solution
ADC1.adc.$suggestSolution = "ADC0";
// Suggest solution
ADC1.adc.adcPin.$suggestSolution = "58";
// Suggest solution
Display1.uart.uart.$suggestSolution = "UART0";
// Suggest solution
Capture2.timer.$suggestSolution = "Timer3";
